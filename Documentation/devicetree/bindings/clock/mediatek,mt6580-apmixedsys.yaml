## Documentation/devicetree/bindings/soc/mediatek/mediatek,mt6580-modem-off.yaml
```yaml
# SPDX-License-Identifier: GPL-2.0-only OR BSD-2-Clause
%YAML 1.2
---
$id: http://devicetree.org/schemas/soc/mediatek/mediatek,mt6580-modem-off.yaml#
$schema: http://devicetree.org/meta-schemas/core.yaml#

title: MediaTek MT6580 unused modem shutdown controller

maintainers:
  - FuQuan <i@fuquan.moe>

description: |
  Quiesces the MD and 2G TOPSM/ABB blocks on boards that never use modem
  firmware, before releasing MD1 through SCPSYS bus isolation and power
  gating. This node claims exclusive ownership of the modem and must not
  coexist with an operational modem/CCCI firmware consumer. It does not
  reclaim reserved modem memory or override SPM hardware request masks.

properties:
  compatible:
    const: mediatek,mt6580-modem-off

  reg:
    items:
      - description: MD TOPSM register block
      - description: 2G TOPSM register block

  reg-names:
    items:
      - const: md-topsm
      - const: 2g-topsm

  power-domains:
    maxItems: 1
    description: MD1 power domain provided by MT6580 SCPSYS

required:
  - compatible
  - reg
  - reg-names
  - power-domains

additionalProperties: false

examples:
  - |
    #include <dt-bindings/power/mt6580-power.h>

    modem-power-controller@20030000 {
        compatible = "mediatek,mt6580-modem-off";
        reg = <0x20030000 0x900>, <0x23010000 0x900>;
        reg-names = "md-topsm", "2g-topsm";
        power-domains = <&scpsys MT6580_POWER_DOMAIN_MD1>;
    };
```

## Documentation/devicetree/bindings/soc/mediatek/mediatek,mt6580-spm-suspend.yaml
```yaml
# SPDX-License-Identifier: GPL-2.0-only OR BSD-2-Clause
%YAML 1.2
---
$id: http://devicetree.org/schemas/soc/mediatek/mediatek,mt6580-spm-suspend.yaml#
$schema: http://devicetree.org/meta-schemas/core.yaml#

title: MediaTek MT6580 SPM suspend controller

maintainers:
  - FuQuan <i@fuquan.moe>

description: |
  Child of the MT6580 SCPSYS power controller. Shares the parent's SPM
  register resource for PCM instruction loading and sleep sequencing;
  MTCMOS power domains remain owned by SCPSYS. The PMIC wrapper supplies
  the autonomous suspend command slots. The PCM return interrupt provides
  timer wakeup. Standby supports staged qualification; automatic deep
  selects the qualified CPU0/infra/DDRPHY and clock handoff profile, with
  retention fallback when prerequisites are busy before hardware entry.

properties:
  mediatek,vproc-retention:
    type: boolean
    description: |
      Opt into the board-qualified MT6350 VPROC hardware sleep policy for
      automatic mem/deep. The provider borrows hardware voltage control,
      the 0.85 V sleep selector and SRCLKEN/oscillator clock handoff only
      across suspend, restoring software ownership before CPUFreq resumes.
      Requires the qualified 1.15 V suspend OPP and matching software/on/
      sleep baseline selectors; unsupported firmware-owned baselines keep
      their existing policy. This is not an active CPU undervolt setting.

  compatible:
    const: mediatek,mt6580-spm-suspend

  mediatek,pwrap:
    $ref: /schemas/types.yaml#/definitions/phandle
    description: MT6580 PMIC wrapper providing the MT6350 suspend command slots

  mediatek,ddr:
    $ref: /schemas/types.yaml#/definitions/phandle
    description: Read-only DDR clock provider auditing BSP SPM prerequisites

  mediatek,clock-controllers:
    $ref: /schemas/types.yaml#/definitions/phandle-array
    minItems: 2
    maxItems: 2
    items:
      maxItems: 1
    description:
      TOPCKGEN followed by APMIXED providers for guarded AXI source
      parking and MAINPLL power control during deep and explicit standby.

  mediatek,uarts:
    $ref: /schemas/types.yaml#/definitions/phandle-array
    minItems: 1
    maxItems: 2
    items:
      maxItems: 1
    description: All enabled MT6580 UART controllers requiring sleep handshake

  interrupts:
    maxItems: 1
    description: SPM IRQ0, used for PCM return and timer wakeup

  mediatek,usbs:
    $ref: /schemas/types.yaml#/definitions/phandle-array
    maxItems: 1
    items:
      maxItems: 1
    description: All enabled MT6580 USB controllers requiring PHY/clock shutdown

  clocks:
    maxItems: 1
    description: SPM register clock

  clock-names:
    const: spm

required:
  - compatible
  - mediatek,pwrap
  - mediatek,ddr
  - mediatek,uarts
  - mediatek,usbs
  - interrupts
  - clocks
  - clock-names

additionalProperties: false

examples:
  - |
    #include <dt-bindings/interrupt-controller/arm-gic.h>
    #include <dt-bindings/interrupt-controller/irq.h>
    #include <dt-bindings/clock/mt6580-clk.h>

    suspend {
        compatible = "mediatek,mt6580-spm-suspend";
        mediatek,pwrap = <&pwrap>;
        mediatek,ddr = <&ddrclk>;
        mediatek,uarts = <&uart0>;
        mediatek,usbs = <&usb>;
        mediatek,clock-controllers = <&topckgen>, <&apmixedsys>;
        interrupts = <GIC_SPI 88 IRQ_TYPE_LEVEL_LOW>;
        clocks = <&topckgen CLK_MT6580_TOP_SPM>;
        clock-names = "spm";
    };
```

## arch/arm/configs/wt6580_we_n_defconfig
```kconfig
CONFIG_LOCALVERSION="-wt6580-bringup"
# CONFIG_LOCALVERSION_AUTO is not set
CONFIG_SYSVIPC=y
CONFIG_NO_HZ_IDLE=y
CONFIG_HIGH_RES_TIMERS=y
CONFIG_IKCONFIG=y
CONFIG_IKCONFIG_PROC=y
CONFIG_LOG_BUF_SHIFT=19
CONFIG_CGROUPS=y
CONFIG_MEMCG=y
CONFIG_CGROUP_SCHED=y
CONFIG_NAMESPACES=y
CONFIG_BLK_DEV_INITRD=y
CONFIG_EXPERT=y
# CONFIG_SYSFS_SYSCALL is not set
CONFIG_PERF_EVENTS=y
CONFIG_ARCH_MULTI_V7=y
CONFIG_ARCH_MEDIATEK=y
# CONFIG_MACH_MT2701 is not set
# CONFIG_MACH_MT6572 is not set
CONFIG_MACH_MT6580=y
# CONFIG_MACH_MT6589 is not set
# CONFIG_MACH_MT6592 is not set
# CONFIG_MACH_MT7623 is not set
# CONFIG_MACH_MT7629 is not set
# CONFIG_MACH_MT8127 is not set
# CONFIG_MACH_MT8135 is not set
# CONFIG_SMP is not set
CONFIG_VMSPLIT_3G=y
CONFIG_HIGHMEM=y
CONFIG_AEABI=y
# CONFIG_ARM_ARCH_TIMER is not set
CONFIG_ARM_APPENDED_DTB=y
# CONFIG_ARM_ATAG_DTB_COMPAT is not set
CONFIG_CMDLINE="earlycon console=ttyS0,921600n8 rdinit=/init loglevel=8 ignore_loglevel clk_ignore_unused pd_ignore_unused panic=15"
CONFIG_CMDLINE_EXTEND=y
CONFIG_CPU_SW_DOMAIN_PAN=y
CONFIG_SECCOMP=y
CONFIG_SECCOMP_FILTER=y
CONFIG_BINFMT_ELF=y
CONFIG_BINFMT_SCRIPT=y
CONFIG_NET=y
CONFIG_UNIX=y
CONFIG_INET=y
# CONFIG_WIRELESS is not set
CONFIG_DEVTMPFS=y
CONFIG_DEVTMPFS_MOUNT=y
# CONFIG_FW_LOADER is not set
# CONFIG_INPUT is not set
# CONFIG_SERIO is not set
# CONFIG_VT is not set
# CONFIG_LEGACY_PTYS is not set
CONFIG_SERIAL_8250=y
CONFIG_SERIAL_8250_CONSOLE=y
CONFIG_SERIAL_8250_NR_UARTS=2
CONFIG_SERIAL_8250_RUNTIME_UARTS=2
CONFIG_SERIAL_8250_MT6577=y
CONFIG_SERIAL_OF_PLATFORM=y
CONFIG_WATCHDOG=y
CONFIG_WATCHDOG_HANDLE_BOOT_ENABLED=y
CONFIG_MEDIATEK_WATCHDOG=y
CONFIG_POWER_RESET=y
CONFIG_POWER_RESET_MT6580_BOOTMODE=y
CONFIG_DRM=y
CONFIG_DRM_MIPI_DSI=y
CONFIG_DRM_PANEL=y
CONFIG_GPIOLIB=y
CONFIG_REGULATOR=y
CONFIG_REGULATOR_FIXED_VOLTAGE=y
CONFIG_BACKLIGHT_CLASS_DEVICE=y
CONFIG_DRM_PANEL_WINGTECH_WT6580=y
CONFIG_FB=y
CONFIG_FB_MT6580_LK=y
CONFIG_USB_SUPPORT=y
# CONFIG_USB is not set
CONFIG_USB_GADGET=y
CONFIG_NOP_USB_XCEIV=y
CONFIG_USB_MUSB_HDRC=y
CONFIG_USB_MUSB_GADGET=y
CONFIG_USB_MUSB_MEDIATEK=y
CONFIG_MUSB_PIO_ONLY=y
CONFIG_PHY_MTK_MT6580_USB=y
CONFIG_COMMON_CLK_MT6580_USB=y
CONFIG_USB_G_SERIAL=y
CONFIG_U_SERIAL_CONSOLE=y
CONFIG_MMC=y
CONFIG_MMC_BLOCK=y
CONFIG_MMC_BLOCK_MINORS=32
CONFIG_MMC_MTK=y
CONFIG_ANDROID_BINDER_IPC=y
CONFIG_ANDROID_BINDERFS=y
CONFIG_ANDROID_BINDER_DEVICES="binder,hwbinder,vndbinder"
CONFIG_EXT4_FS=y
CONFIG_EXT4_FS_POSIX_ACL=y
CONFIG_EXT4_FS_SECURITY=y
CONFIG_QUOTA=y
CONFIG_QFMT_V2=y
CONFIG_TMPFS=y
CONFIG_TMPFS_POSIX_ACL=y
CONFIG_PSTORE=y
CONFIG_PSTORE_CONSOLE=y
CONFIG_PSTORE_PMSG=y
CONFIG_PSTORE_RAM=y
CONFIG_PRINTK_TIME=y
CONFIG_DEBUG_FS=y
CONFIG_MAGIC_SYSRQ=y
CONFIG_DEBUG_KERNEL=y
CONFIG_STACKTRACE=y
CONFIG_FTRACE=y
CONFIG_FTRACE_SYSCALLS=y
CONFIG_BPF_SYSCALL=y
CONFIG_BPF_JIT=y
CONFIG_KEYBOARD_GPIO=y
CONFIG_PINCTRL_AW9523=y
CONFIG_GPIO_AW9106=y
```

## drivers/gpu/arm/mali-utgard/Kconfig
```kconfig
# SPDX-License-Identifier: GPL-2.0
config MALI400
	tristate "Mali-400 Utgard r8p0 legacy userspace driver (MT6580)"
	depends on ARM && ARCH_MEDIATEK && OF && PM && HAS_DMA
	depends on DRM_LIMA = n
	select DMA_SHARED_BUFFER
	select SYNC_FILE
	help
	  GPL Arm Utgard r8p0-00dev0 driver adapted for Linux 6.18 and the
	  MT6580 Mali-400 MP2. Provides the original API 900 /dev/mali ABI
	  for matching proprietary EGL/GLES userspace, with dma-buf and
	  Linux sync_file support. This is separate from the KMS display driver.

	  Runtime and system PM are supported. The shared supply remains under
	  CPU voltage control; optional devfreq changes only GPU clock sources.
	  Protected rendering is not supported.
	  Disable Lima: both drivers target the same GPU and cannot own it
	  simultaneously. No proprietary userspace binaries are included.

config MALI400_DEBUG
	bool "Utgard driver debugging and assertions"
	depends on MALI400
	help
	  Compile the DDK's diagnostic messages and internal assertions.
	  The mali_debug_level parameter controls message verbosity at runtime.

config MALI400_DEVFREQ
	bool "MT6580 Utgard devfreq clock scaling"
	depends on MALI400 && PM_DEVFREQ && PM_OPP
	select DEVFREQ_GOV_SIMPLE_ONDEMAND
	help
	  Use the five BSP GPU clock steps from 107.25 to 500.5 MHz with
	  measured busy time and the simple ondemand governor. The CPU's
	  shared VPROC supply must remain at or above 1.15 V; GPU devfreq
	  never changes its voltage. Runtime suspend stops polling.
```

## drivers/misc/mediatek/mt6580-connectivity/Kconfig
```kconfig
# SPDX-License-Identifier: GPL-2.0-only
config MT6580_CONSYS
	bool "MT6580 integrated connectivity management and STP"
	depends on ARCH_MEDIATEK && OF && PM && REGULATOR && COMMON_CLK && NET
	select CRC16
	select CRC32
	select ZLIB_DEFLATE
	help
	  Real CONSYS power, BTIF/STP transport, ROM-patch loader and WMT
	  function management for the integrated MT6580 connectivity block.
	  The associated WLAN driver communicates with its firmware via AHB.
```

## drivers/net/wireless/mediatek/Kconfig
```kconfig
# SPDX-License-Identifier: GPL-2.0-only
config WLAN_VENDOR_MEDIATEK
	bool "MediaTek devices"
	default y
	help
	  If you have a wireless card belonging to this class, say Y.

	  Note that the answer to this question doesn't directly affect the
	  kernel: saying N will just cause the configurator to skip all the
	  questions about these cards. If you say Y, you will be asked for
	  your specific card in the following questions.

if WLAN_VENDOR_MEDIATEK
config MT6580_WLAN
	bool "MT6580 integrated AHB wireless LAN"
	depends on ARCH_MEDIATEK && CFG80211 && MT6580_CONSYS
	select CFG80211_WEXT
	help
	  MediaTek's integrated MT6580 WLAN with the original firmware protocol
	  and AHB programmed I/O transport. Requires the MT6580 CONSYS/WMT core.

source "drivers/net/wireless/mediatek/mt7601u/Kconfig"
source "drivers/net/wireless/mediatek/mt76/Kconfig"
endif # WLAN_VENDOR_MEDIATEK
```

## drivers/soc/mediatek/Kconfig
```kconfig
# SPDX-License-Identifier: GPL-2.0-only
#
# MediaTek SoC drivers
#
menu "MediaTek SoC drivers"
	depends on ARCH_MEDIATEK || COMPILE_TEST

config MTK_CMDQ
	tristate "MediaTek CMDQ Support"
	depends on ARCH_MEDIATEK || COMPILE_TEST
	select MAILBOX
	select MTK_CMDQ_MBOX
	select MTK_INFRACFG
	help
	  Say yes here to add support for the MediaTek Command Queue (CMDQ)
	  driver. The CMDQ is used to help read/write registers with critical
	  time limitation, such as updating display configuration during the
	  vblank.

config MTK_DEVAPC
	tristate "Mediatek Device APC Support"
	help
	  Say yes here to enable support for Mediatek Device APC driver.
	  This driver is mainly used to handle the violation which catches
	  unexpected transaction.
	  The violation information is logged for further analysis or
	  countermeasures.

config MTK_DVFSRC
	tristate "MediaTek DVFSRC Support"
	depends on ARCH_MEDIATEK
	help
	  Say yes here to add support for the MediaTek Dynamic Voltage
	  and Frequency Scaling Resource Collector (DVFSRC): a HW
	  IP found on many MediaTek SoCs, which is responsible for
	  collecting DVFS requests from various SoC IPs, other than
	  software, and performing bandwidth scaling to provide the
	  best achievable performance-per-watt.

config MTK_INFRACFG
	tristate "MediaTek INFRACFG Support"
	select REGMAP
	help
	  Say yes here to add support for the MediaTek INFRACFG controller. The
	  INFRACFG controller contains various infrastructure registers not
	  directly associated to any device.

config MTK_PMIC_WRAP
	tristate "MediaTek PMIC Wrapper Support"
	depends on RESET_CONTROLLER
	depends on OF
	select REGMAP
	help
	  Say yes here to add support for MediaTek PMIC Wrapper found
	  on different MediaTek SoCs. The PMIC wrapper is a proprietary
	  hardware to connect the PMIC.

config MTK_MT6580_PMIC_WRAP
	tristate "MT6580 firmware-initialized PMIC wrapper"
	depends on OF
	select REGMAP
	help
	  Share the firmware-initialized WACS2 channel between MT6350
	  regulators and RTC reboot-mode control. Provide the SPM suspend
	  command-slot handoff without reinitializing PWRAP.

config MTK_MT6580_SPM
	bool "MT6580 SPM system suspend support"
	depends on ARM && MACH_MT6580 && SUSPEND
	depends on MTK_SCPSYS && MTK_MT6580_PMIC_WRAP=y
	depends on SERIAL_8250_MT6577=y
	depends on USB_MUSB_MEDIATEK=y
	depends on COMMON_CLK_MT6580_USB=y
	depends on CPU_PM && ARM_CPU_SUSPEND
	help
	  Execute the BSP PCM program for standby and automatic deep system
	  suspend, with timer/external wakeup and MT6350 command slots. Deep
	  sleep uses CPU0/TOP/L2, infra and DDRPHY power-down with guarded
	  APSRC/F26M handoff and counter-based sleep accounting. A busy
	  prerequisite falls back to retention before hardware sleep. Explicit
	  standby also supports staged MMU-off and power-down qualification.
	  GIC, banked registers and L2 state are restored. UART and USB clock/PHY
	  shutdown gate the software 26 MHz override. The DDR supplier audits
	  BSP prerequisites without changing memory timings. Suspend voltage
	  and MAINPLL power policy remain retained.
	  Firmware-initialized MT6350 PWRAP and CIRQ are required.

config MTK_MT6580_MODEM_OFF
	bool "MT6580 unused modem shutdown"
	depends on MACH_MT6580 && PM && MTK_SCPSYS=y
	help
	  Quiesce the internal MD/2G TOPSM and ABB on boards that never use
	  the modem, then release the MD1 power domain through genpd. The
	  dedicated DT node must not coexist with a modem firmware driver.
	  Reserved modem RAM and SPM hardware arbitration masks stay intact.

config MTK_REGULATOR_COUPLER
	bool "MediaTek SoC Regulator Coupler" if COMPILE_TEST
	default ARCH_MEDIATEK
	depends on REGULATOR

config MTK_MMSYS
	tristate "MediaTek MMSYS Support"
	default ARCH_MEDIATEK
	depends on HAS_IOMEM
	depends on MTK_CMDQ || MTK_CMDQ=n
	help
	  Say yes here to add support for the MediaTek Multimedia
	  Subsystem (MMSYS).

config MTK_SVS
	tristate "MediaTek Smart Voltage Scaling(SVS)"
	depends on NVMEM_MTK_EFUSE && NVMEM
	help
	  The Smart Voltage Scaling(SVS) engine is a piece of hardware
	  which has several controllers(banks) for calculating suitable
	  voltage to different power domains(CPU/GPU/CCI) according to
	  chip process corner, temperatures and other factors. Then DVFS
	  driver could apply SVS bank voltage to PMIC/Buck.

config MTK_SOCINFO
	tristate "MediaTek SoC Information"
	default y
	depends on NVMEM_MTK_EFUSE
	select SOC_BUS
	help
	  The MediaTek SoC Information (mtk-socinfo) driver provides
	  information about the SoC to the userspace including the
	  manufacturer name, marketing name and soc name.

endmenu
```
