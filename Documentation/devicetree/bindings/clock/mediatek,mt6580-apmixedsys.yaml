## Documentation/devicetree/bindings/clock/mediatek,mt6580-apmixedsys.yaml
```yaml
# SPDX-License-Identifier: (GPL-2.0-only OR BSD-2-Clause)
%YAML 1.2
---
$id: http://devicetree.org/schemas/clock/mediatek,mt6580-apmixedsys.yaml#
$schema: http://devicetree.org/meta-schemas/core.yaml#

title: MediaTek MT6580 analog PLL and CPU clock controller

maintainers:
  - FuQuan <i@fuquan.moe>

description: |
  Provides firmware-configured MAINPLL/UNIVPLL, ARMPLL CPU frequency changes
  and USB/MIPI reference gates. INFRACFG contains the CPU mux/divider and
  ARMPLL auto-gating controls. Optional narrow MCUCFG and BIU regions permit
  ownership of the MT6580 CG1 and CG3 bus DCM bits. The existing L2 /2 divider
  is checked but never written. The MCUCFG region excludes offset0, whose
  L2 reset/retention policy is owned by CPU PM. It does not enable SRAM DCM.

properties:
  compatible:
    const: mediatek,mt6580-apmixedsys
  reg:
    minItems: 2
    maxItems: 4
    items:
      - description: APMIXEDSYS
      - description: INFRACFG AO
      - description: MCUCFG MISC_CONFIG and ACLKEN_DIV, offset0x5c, size8
      - description: BIU CON, offset0, size4
  reg-names:
    minItems: 2
    maxItems: 4
    items:
      - const: apmixedsys
      - const: infracfg
      - const: mcusys-dcm
      - const: biu
  '#clock-cells':
    const: 1

required:
  - compatible
  - reg
  - '#clock-cells'

allOf:
  - if:
      properties:
        reg:
          minItems: 3
    then:
      properties:
        reg:
          minItems: 4
      required:
        - reg-names

additionalProperties: false
```

## Documentation/devicetree/bindings/clock/mediatek,mt6580-ddrphy-clock.yaml
```yaml
# SPDX-License-Identifier: (GPL-2.0-only OR BSD-2-Clause)
%YAML 1.2
---
$id: http://devicetree.org/schemas/clock/mediatek,mt6580-ddrphy-clock.yaml#
$schema: http://devicetree.org/meta-schemas/core.yaml#

title: MediaTek MT6580 firmware memory clock

maintainers:
  - Matthias Brugger <matthias.bgg@gmail.com>

description:
  Read-only provider for the firmware-programmed EMI memory source. PLL fields
  are distributed across DDRPHY and the DRAMC AO/NAO register mirrors. The clock
  rate is one quarter of the DDR data rate. This provider does not reprogram
  memory timings, switch PLL modes or implement DDR self-refresh.

properties:
  compatible:
    const: mediatek,mt6580-ddrphy-clock

  reg:
    items:
      - description: DDRPHY registers
      - description: DRAMC always-on register mirror
      - description: DRAMC non-always-on register mirror

  reg-names:
    items:
      - const: ddrphy
      - const: dramc-ao
      - const: dramc-nao

  clocks:
    maxItems: 1

  clock-names:
    const: xtal

  '#clock-cells':
    const: 0

required:
  - compatible
  - reg
  - reg-names
  - clocks
  - clock-names
  - '#clock-cells'

additionalProperties: false
```

## Documentation/devicetree/bindings/clock/mediatek,mt6580-imgsys.yaml
```yaml
# SPDX-License-Identifier: (GPL-2.0-only OR BSD-2-Clause)
%YAML 1.2
---
$id: http://devicetree.org/schemas/clock/mediatek,mt6580-imgsys.yaml#
$schema: http://devicetree.org/meta-schemas/core.yaml#

title: MediaTek MT6580 image subsystem clock controller

maintainers:
  - Matthias Brugger <matthias.bgg@gmail.com>

description:
  IMGSYS provides the LARB1 and shared video codec gates in the ISP power
  domain. Clock indices are defined in dt-bindings/clock/mt6580-clk.h.
  The physical upstream routing is not established by this binding.

properties:
  compatible:
    const: mediatek,mt6580-imgsys

  reg:
    maxItems: 1

  '#clock-cells':
    const: 1

  power-domains:
    maxItems: 1

required:
  - compatible
  - reg
  - '#clock-cells'
  - power-domains

additionalProperties: false
```

## Documentation/devicetree/bindings/crypto/mediatek,mt6580-hacc.yaml
```yaml
# SPDX-License-Identifier: (GPL-2.0-only OR BSD-2-Clause)
%YAML 1.2
---
$id: http://devicetree.org/schemas/crypto/mediatek,mt6580-hacc.yaml#
$schema: http://devicetree.org/meta-schemas/core.yaml#

title: MediaTek MT6580 HACC software-key AES engine

maintainers:
  - FuQuan <i@fuquan.moe>

description: |
  HACC at 0x1000a000 implements software-key AES ECB/CBC. The driver polls
  the documented ACON2 ready bit and only accesses software-key/data control
  registers through offset 0x5c. Hardware-bound keys, OTP, SECINIT, secure
  boot and legacy vendor ioctls are not part of this binding. The bus clock
  is MT6580 TOP CG_CTRL1 bit21 (SEJ). Its physical parent is unspecified;
  the clock provider exposes the verified gate without inventing a rate.

properties:
  compatible:
    const: mediatek,mt6580-hacc
  reg:
    maxItems: 1
  clocks:
    maxItems: 1
  clock-names:
    const: bus

required:
  - compatible
  - reg
  - clocks
  - clock-names

additionalProperties: false
```

## Documentation/devicetree/bindings/extcon/mediatek,mt6350-usb.yaml
```yaml
# SPDX-License-Identifier: GPL-2.0-only OR BSD-2-Clause
%YAML 1.2
---
$id: http://devicetree.org/schemas/extcon/mediatek,mt6350-usb.yaml#
$schema: http://devicetree.org/meta-schemas/core.yaml#

title: MediaTek MT6350 USB VBUS detector

maintainers:
  - FuQuan <i@fuquan.moe>

description:
  Child of the MT6350 PMIC. Reports physical VBUS presence through extcon
  and uses the PMIC CHRDET interrupt to wake the system on cable changes.
  The parent MFD supplies the interrupt resource. This block does not
  implement charger current, voltage or USB data-role policy.

properties:
  compatible:
    const: mediatek,mt6350-usb

  wakeup-source: true

required:
  - compatible

additionalProperties: false

examples:
  - |
    usb {
        compatible = "mediatek,mt6350-usb";
        wakeup-source;
    };
```

## Documentation/devicetree/bindings/gpio/awinic,aw9106.yaml
```yaml
# SPDX-License-Identifier: (GPL-2.0-only OR BSD-2-Clause)
%YAML 1.2
---
$id: http://devicetree.org/schemas/gpio/awinic,aw9106.yaml#
$schema: http://devicetree.org/meta-schemas/core.yaml#

title: Awinic AW9106 GPIO controller

maintainers:
  - FuQuan <i@fuquan.moe>

description: |
  The AW9106 provides six I/O channels that can operate as GPIOs or LED
  outputs. GPIO offsets 0 through 5 correspond to the OUT0 through OUT5
  package pin names. OUT0 through OUT3 occupy bits 0 through 3 of register
  bank 1, while OUT4 and OUT5 occupy bits 0 and 1 of bank 0.

  GPIO inputs require external bias resistors; the active-low INTN output
  requires an external pull-up.
  Only channels requested as GPIOs are switched to GPIO mode. The GPIO
  driver does not configure the remaining channels as LED outputs.

properties:
  compatible:
    const: awinic,aw9106

  reg:
    maxItems: 1

  gpio-controller: true

  '#gpio-cells':
    const: 2

  gpio-line-names:
    maxItems: 6

  interrupt-controller: true

  '#interrupt-cells':
    const: 2
    description: GPIO offset and interrupt flags; both-edge interrupts only.

  interrupts:
    maxItems: 1
    description: The active-low INTN output.

  reset-gpios:
    maxItems: 1
    description: The active-low SHDN reset input.

required:
  - compatible
  - reg
  - gpio-controller
  - '#gpio-cells'
  - reset-gpios

dependencies:
  interrupt-controller: [ interrupts, '#interrupt-cells' ]
  '#interrupt-cells': [ interrupt-controller ]
  interrupts: [ interrupt-controller ]

additionalProperties: false

examples:
  - |
    #include <dt-bindings/gpio/gpio.h>
    #include <dt-bindings/interrupt-controller/irq.h>

    i2c {
        #address-cells = <1>;
        #size-cells = <0>;

        gpio-expander@5b {
            compatible = "awinic,aw9106";
            reg = <0x5b>;
            gpio-controller;
            #gpio-cells = <2>;
            interrupt-controller;
            #interrupt-cells = <2>;
            interrupt-parent = <&pio>;
            interrupts = <6 IRQ_TYPE_LEVEL_LOW>;
            reset-gpios = <&pio 73 GPIO_ACTIVE_LOW>;
        };
    };
```

## Documentation/devicetree/bindings/misc/mediatek,mt6580-vcodec.yaml
```yaml
# SPDX-License-Identifier: (GPL-2.0-only OR BSD-2-Clause)
%YAML 1.2
---
$id: http://devicetree.org/schemas/misc/mediatek,mt6580-vcodec.yaml#
$schema: http://devicetree.org/meta-schemas/core.yaml#

title: MediaTek MT6580 video codec

maintainers:
  - Matthias Brugger <matthias.bgg@gmail.com>

description:
  MT6580 decoder MISC and VLD share a two-page window in the ISP domain.
  Its memory traffic uses LARB1 POST0, CDMA and WDMA ports. The initial
  driver manages owned DMA buffers and decoder jobs through M4U. H.264 also
  uses the separate MP4-VENC register block as an auxiliary engine. This is
  not compatible with MT8173 V4L2 hardware.

properties:
  compatible:
    const: mediatek,mt6580-vcodec

  reg:
    items:
      - description: VDEC MISC and VLD register window
      - description: MP4-VENC auxiliary register window

  reg-names:
    items:
      - const: vdec
      - const: mp4-venc

  interrupts:
    maxItems: 1

  clocks:
    maxItems: 1

  clock-names:
    const: vcodec

  power-domains:
    maxItems: 1

  iommus:
    items:
      - description: LARB1 port 3, decoder POST0
      - description: LARB1 port 9, decoder CDMA
      - description: LARB1 port 10, decoder WDMA

required:
  - compatible
  - reg
  - reg-names
  - interrupts
  - clocks
  - clock-names
  - power-domains
  - iommus

additionalProperties: false
```

## Documentation/devicetree/bindings/pinctrl/mediatek,mt6580-pinctrl.yaml
```yaml
# SPDX-License-Identifier: (GPL-2.0-only OR BSD-2-Clause)
%YAML 1.2
---
$id: http://devicetree.org/schemas/pinctrl/mediatek,mt6580-pinctrl.yaml#
$schema: http://devicetree.org/meta-schemas/core.yaml#

title: MediaTek MT6580 pin controller

maintainers:
  - FuQuan <i@fuquan.moe>

description: |
  GPIO, pin multiplexing, IOCFG and external interrupts on MT6580. GPIO0..15
  have direct EINT mappings; other pins share interrupt channels and their
  routing is not supported yet.

allOf:
  - $ref: pinctrl.yaml#

properties:
  compatible:
    const: mediatek,mt6580-pinctrl
  reg:
    maxItems: 6
  reg-names:
    items:
      - const: gpio
      - const: iocfg-t
      - const: iocfg-b
      - const: iocfg-l
      - const: iocfg-r
      - const: eint
  gpio-controller: true
  '#gpio-cells':
    const: 2
  gpio-ranges:
    maxItems: 1
  interrupt-controller: true
  '#interrupt-cells':
    const: 2
  interrupts:
    maxItems: 1

patternProperties:
  '-pins$':
    type: object
    additionalProperties: false
    patternProperties:
      '^pins':
        type: object
        allOf:
          - $ref: pincfg-node.yaml#
          - $ref: pinmux-node.yaml#
        properties:
          pinmux: true
          bias-disable: true
          bias-pull-up: true
          bias-pull-down: true
          input-enable: true
          input-disable: true
          input-schmitt-enable: true
          input-schmitt-disable: true
          output-low: true
          output-high: true
        required:
          - pinmux
        additionalProperties: false

required:
  - compatible
  - reg
  - reg-names
  - gpio-controller
  - '#gpio-cells'
  - gpio-ranges
  - interrupt-controller
  - '#interrupt-cells'
  - interrupts

additionalProperties: false
```

## Documentation/devicetree/bindings/power/supply/mediatek,mt6350-battery.yaml
```yaml
# SPDX-License-Identifier: (GPL-2.0-only OR BSD-2-Clause)
%YAML 1.2
---
$id: http://devicetree.org/schemas/power/supply/mediatek,mt6350-battery.yaml#
$schema: http://devicetree.org/meta-schemas/core.yaml#

title: MediaTek MT6350 AUXADC battery monitor

maintainers:
  - FuQuan <i@fuquan.moe>

description: |
  Battery voltage, presence and thermistor monitor within MT6350. Capacity is
  estimated from the board OCV curve; this is not a hardware coulomb counter.
  The thermistor circuit uses the MT6580 BSP 10 kohm NTC with a 16.9 kohm
  pull-up to 1.8 V and 27 kohm pull-down.

allOf:
  - $ref: power-supply.yaml#

properties:
  compatible:
    const: mediatek,mt6350-battery
  monitored-battery:
    description: Battery characteristics and OCV/capacity tables.
  power-supplies:
    maxItems: 1

required:
  - compatible
  - monitored-battery
  - power-supplies

additionalProperties: false
```

## Documentation/devicetree/bindings/regulator/mediatek,mt6350-regulator.yaml
```yaml
# SPDX-License-Identifier: (GPL-2.0-only OR BSD-2-Clause)
%YAML 1.2
---
$id: http://devicetree.org/schemas/regulator/mediatek,mt6350-regulator.yaml#
$schema: http://devicetree.org/meta-schemas/core.yaml#

title: MediaTek MT6350 VGP1 regulator

maintainers:
  - FuQuan <i@fuquan.moe>

description:
  VGP1 supply accessed through the parent MT6580 PMIC wrapper regmap.

properties:
  compatible:
    const: mediatek,mt6350-regulator
  ldo_vgp1:
    type: object
    $ref: regulator.yaml#
    unevaluatedProperties: false

required:
  - compatible
  - ldo_vgp1

additionalProperties: false
```

## Documentation/devicetree/bindings/soc/mediatek/mediatek,mt6580-firmware-pwrap.yaml
```yaml
# SPDX-License-Identifier: (GPL-2.0-only OR BSD-2-Clause)
%YAML 1.2
---
$id: http://devicetree.org/schemas/soc/mediatek/mediatek,mt6580-firmware-pwrap.yaml#
$schema: http://devicetree.org/meta-schemas/core.yaml#

title: MT6580 MT6350 PMIC wrapper

maintainers:
  - FuQuan <i@fuquan.moe>

description: |
  Provides serialized MT6350 register access over WACS2. The firmware-pwrap
  compatible requires an initialized link and never initializes or resets it.
  The mt6580-pwrap compatible can initialize an unconfigured link before any
  PMIC consumers are registered, using the TOPRGU SPI reset and TOPCKGEN
  gates. An already initialized link is retained during normal startup.
  When clocks are supplied, they remain enabled for PMIC IRQ, regulator and
  final power-off register access throughout the wrapper's lifetime.

properties:
  compatible:
    enum:
      - mediatek,mt6580-firmware-pwrap
      - mediatek,mt6580-pwrap
  reg:
    maxItems: 1
  clocks:
    items:
      - description: AP PMIC SPI clock using the firmware-selected source
      - description: PMIC 26 MHz clock
  clock-names:
    items:
      - const: spi
      - const: 26m
  resets:
    maxItems: 1
  reset-names:
    const: spi
  mediatek,topckgen:
    $ref: /schemas/types.yaml#/definitions/phandle
    description:
      MT6580 TOPCKGEN supplier owning the SET/CLR gates and PMIC bclk DCM
      control used around the initial PWRAP SPI reset.
  reboot-mode:
    type: object
    additionalProperties: false
    properties:
      compatible:
        const: wingtech,wt6580-reboot-mode
    required:
      - compatible
  regulators:
    $ref: /schemas/regulator/mediatek,mt6350-regulator.yaml#
  pmic:
    $ref: /schemas/mfd/mediatek,mt6397.yaml#

required:
  - compatible
  - reg

dependencies:
  clocks: [clock-names]
  clock-names: [clocks]
  resets: [reset-names]
  reset-names: [resets]

allOf:
  - if:
      properties:
        compatible:
          const: mediatek,mt6580-pwrap
    then:
      required:
        - clocks
        - clock-names
        - resets
        - reset-names
        - mediatek,topckgen

additionalProperties: false
```
